## components/usbdev/Kconfig
```kconfig
menu "Grillo USB"
    config GRILLO_USB_DEBUG_CDC
        bool "Debug console on the USB CDC serial port"
        default y
        help
            When TinyUSB owns the USB PHY the USB-Serial-JTAG console is gone.
            The HID profiles always expose a CDC-ACM serial port (used by the
            injector's host.ask/host.run back channel). With this option the
            debug console and the ESP-IDF logs also use it, and the USB disk
            profile gets a CDC port too. Disable it for release builds.
endmenu
```
